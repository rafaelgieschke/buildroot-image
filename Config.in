## external-packages/Config.in
```kconfig
source "$BR2_EXTERNAL_WEBSERVER_CONF_PATH/package/setup-network/Config.in"
source "$BR2_EXTERNAL_WEBSERVER_CONF_PATH/package/kernel-uncompressed/Config.in"
```

## external-packages/package/kernel-uncompressed/Config.in
```kconfig
config BR2_LINUX_KERNEL_EXT_UNCOMPRESSED
	bool "kernel_uncompressed"
	help
	  Treat BR2_LINUX_KERNEL_XZ as uncompressed kernel.
```

## external-packages/package/setup-network/Config.in
```kconfig
config BR2_PACKAGE_SETUP_NETWORK
	bool "setup_network"
	help
	  Set IP at start-up.
```
